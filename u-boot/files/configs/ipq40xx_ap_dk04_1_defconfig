## u-boot/files/configs/ipq40xx_ap_dk04_1_defconfig
```kconfig
CONFIG_TEXT_BASE=0x84000000
CONFIG_MTD=y
CONFIG_SPI=y
CONFIG_ARM=y
CONFIG_ARCH_IPQ40XX=y
CONFIG_DEFAULT_DEVICE_TREE="qcom-ipq4019-ap.dk04.1-c1"
CONFIG_SYS_LOAD_ADDR=0x84000000
CONFIG_DEBUG_UART_BASE=0x78af000
CONFIG_DEBUG_UART_CLOCK=1843200
CONFIG_DEBUG_UART=y
CONFIG_FIT=y
CONFIG_POWER_DOMAIN=y
CONFIG_MSM_SERIAL=y
# CONFIG_TOOLS_LIBCRYPTO is not set
# CONFIG_TOOLS_KWBIMAGE is not set
# CONFIG_TOOLS_MKEFICAPSULE is not set
CONFIG_DM_SPI=y
CONFIG_SPI_QUP=y
CONFIG_DM_SPI_FLASH=y
CONFIG_CMD_SF=y
CONFIG_SPI_FLASH_MACRONIX=y
CONFIG_CMD_BOOTM=y
CONFIG_ENV_IS_NOWHERE=y
CONFIG_DM_GPIO=y
CONFIG_MSM_GPIO=y
CONFIG_DM_MDIO=y
CONFIG_MDIO_IPQ4019=y
CONFIG_ESSEDMA=y
CONFIG_PHYLIB=y
CONFIG_IPADDR="172.18.0.136"
CONFIG_SERVERIP="172.18.0.134"
CONFIG_NETMASK="255.255.255.0"
CONFIG_USE_IPADDR=y
CONFIG_USE_NETMASK=y
CONFIG_USE_SERVERIP=y
CONFIG_CMD_MII=y
CONFIG_CMD_MDIO=y
CONFIG_CMD_ETHSW=y
```
